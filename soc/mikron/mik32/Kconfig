## soc/mikron/mik32/Kconfig
```kconfig
config SOC_MIK32
	select RISCV
	select RISCV_ISA_RV32I
	select RISCV_ISA_EXT_M
	select ATOMIC_OPERATIONS_C
	select RISCV_ISA_EXT_C
	select RISCV_ISA_EXT_ZICSR
	select RISCV_ISA_EXT_ZIFENCEI
	select RISCV_SOC_HAS_GP_RELATIVE_ADDRESSING
	select XIP
 	select GNU_C_EXTENSIONS
	select BUILD_OUTPUT_HEX
	select RISCV_SOC_HAS_CUSTOM_IRQ_HANDLING
	select INCLUDE_RESET_VECTOR
	select NON_POWER_OF_2_ISR_ALIGNMENT_FIXUP
	select RISCV_JUMP_TO_CODE
	select RISCV_USE_START_AS_MTVEC
  select DYNAMIC_INTERRUPTS

	#	select RISCV_PRIVILEGED
```

## soc/mikron/mik32/Kconfig.defconfig
```kconfig
if SOC_MIK32

config NUM_IRQS
        default 32

config SYS_CLOCK_HW_CYCLES_PER_SEC
	default 100000

config SYS_CLOCK_TICKS_PER_SEC
	default 10

config GEN_ISR_TABLES
	default n

config GEN_SW_ISR_TABLE
	default n

config GEN_IRQ_VECTOR_TABLE
	default n

config RISCV_VECTORED_MODE
	default n

config RISCV_RESERVED_IRQ_ISR_TABLES_OFFSET
	default 0

config OUTPUT_DISASSEMBLY
	default y

config BUILD_OUTPUT_HEX_GAP_FILL
	default y

config ISR_FIXUP_SECTION_ALIGNMENT
	default 0x80

config ISR_FIXUP_SECTION_OFFSET
	default 0x40

config RISCV_JUMP_TO_CODE_OFFSET
	default 0x80000

config RISCV_MCAUSE_EXCEPTION_MASK
	default 0xf

config RV_BOOT_HART
	default -558821375

endif # SOC_MIK32
```

## soc/mikron/mik32/Kconfig.soc
```kconfig
config SOC_MIK32
        bool

config SOC
        default "MIK32" if SOC_MIK32

config NON_POWER_OF_2_ISR_ALIGNMENT_FIXUP
	bool "Wrap isr into fixup section which can be aligned in linker script"
	default n

if NON_POWER_OF_2_ISR_ALIGNMENT_FIXUP
config ISR_FIXUP_SECTION_OFFSET
	hex "ISR fixup section relative offset"
	default 0x40

config ISR_FIXUP_SECTION_ALIGNMENT
	hex "ISR fixup section alignment in linker script"
	default 0x80

endif # NON_POWER_OF_2_ISR_ALIGNMENT_FIXUP

config RISCV_JUMP_TO_CODE
	bool "Jump into proper address where code actually resides on start"
	default n

if RISCV_JUMP_TO_CODE
config RISCV_JUMP_TO_CODE_OFFSET
	hex "Offset for auipc to jump into"
	default 0x80000

endif # RISCV_JUMP_TO_CODE

config RISCV_USE_START_AS_MTVEC
	bool "Put _start address into mtvec instead of isr_wrapper address"
	default n
```
