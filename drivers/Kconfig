## drivers/Kconfig
```kconfig
# Copyright (c) 2024
# SPDX-License-Identifier: Apache-2.0

menu "Drivers"
rsource "*/Kconfig"
endmenu
```

## drivers/clock_control/Kconfig.mikron
```kconfig
# Copyright (c) 2022 Teslabs Engineering S.L.
# SPDX-License-Identifier: Apache-2.0

config CLOCK_CONTROL_MIK32
	bool "MIK32 clock control (PowerManager)"
	default y
	depends on DT_HAS_MIKRON_MIK32_PMGR_ENABLED
	help
	  Enable driver for Mikron PowerManager.
```

## drivers/eeprom/Kconfig
```kconfig
# EEPROM driver configuration options

# Copyright (c) 2024
# SPDX-License-Identifier: Apache-2.0

if EEPROM

module = EEPROM
module-str = eeprom
source "subsys/logging/Kconfig.template.log_config"

config EEPROM_MIK32_8K_BLK
	bool "Mikron 8k blk EEPROM driver"
	default n
	depends on DT_HAS_MIKRON_8K_BLK_ENABLED
	help
	  Enable support for Mikron 8k blk EEPROM driver.

endif # EEPROM
```

## drivers/gpio/Kconfig
```kconfig
# Memory controller configuration options

# Copyright (c) 2024
# SPDX-License-Identifier: Apache-2.0

if GPIO

module = GPIO
module-str = gpio
source "subsys/logging/Kconfig.template.log_config"

rsource "./Kconfig.*"

endif
```

## drivers/gpio/Kconfig.mikron
```kconfig
# Copyright (c) 2024
# SPDX-License-Identifier: Apache-2.0

config GPIO_MIK32
	bool "Mikron GPIO Controller"
	default y
	depends on DT_HAS_MIKRON_MIK32_GPIO_ENABLED
	help
	  Enable Mikron MIK32 GPIO Controller.
```

## drivers/i2c/Kconfig
```kconfig
# Memory controller configuration options

# Copyright (c) 2025 Excave.ru
# SPDX-License-Identifier: Apache-2.0

if I2C

module = I2C
module-str = i2c
source "subsys/logging/Kconfig.template.log_config"

rsource "./Kconfig.*"

endif
```

## drivers/i2c/Kconfig.mikron
```kconfig
# Copyright (c) 2025 Excave.ru
# SPDX-License-Identifier: Apache-2.0

config I2C_MIK32
	bool "Mikron MIK32 I2C driver"
	default y
	depends on DT_HAS_MIKRON_MIK32_I2C_ENABLED
	select PINCTRL
	help
	  This option enables the I2C driver for MIK32 SoC family.
```

## drivers/interrupt_controller/Kconfig.mikron
```kconfig
# Copyright (c) 2024 Escave
# SPDX-License-Identifier: Apache-2.0

config MIK32_GPIO_IRQ
	bool "MIK32 GPIO Interrupts Controller"
	default y
	depends on DT_HAS_MIKRON_MIK32_GPIO_IRQ_ENABLED
	help
	  Enable the MIKRON MIK32 GPIO Interrupts Controller driver.

config MIK32_EPIC
	bool "MIK32 Interrupt Controller"
	default y
	depends on DT_HAS_MIKRON_EPIC_ENABLED
	help
	  Enable the MIKRON MIK32 EPIC Interrupt Controller driver.
```

## drivers/memc/Kconfig.mikron
```kconfig
# Copyright (c) 2024
# SPDX-License-Identifier: Apache-2.0

config MEMC_MIKRON_SPIFI
	bool "Mikron SPIFI Memory Controller"
	default y
	depends on DT_HAS_MIKRON_SPIFI_ENABLED
	help
	  Enable Mikron SPIFI Memory Controller.
```

## drivers/pinctrl/Kconfig.mikron
```kconfig
# Copyright (c) 2024
# SPDX-License-Identifier: Apache-2.0

config PINCTRL_MIK32_AF
	bool "MIK32 AF pin controller driver"
	default y
	depends on DT_HAS_MIKRON_MIK32_PINCTRL_AF_ENABLED
	help
	  MIK32 AF pin controller driver. This driver is used by series using the
	  AF pin multiplexing model.
```

## drivers/serial/Kconfig.mikron
```kconfig
# Copyright (c) 2024
# SPDX-License-Identifier: Apache-2.0

config UART_MIKRON_MIK32_USART
	bool "Mikron MIK32 USART driver"
	default y
	depends on DT_HAS_MIKRON_MIK32_USART_ENABLED
	select SERIAL_HAS_DRIVER
	select SERIAL_SUPPORT_INTERRUPT
	select PINCTRL
	help
	  This option enables the USART driver for MIK32 SoC family.
```

## drivers/spi/Kconfig.mikron
```kconfig
# Copyright (c) 2025 Excave.ru
# SPDX-License-Identifier: Apache-2.0

config SPI_MIK32
	bool "Mikron MIK32 SPI driver"
	default y
	depends on DT_HAS_MIKRON_MIK32_SPI_ENABLED
	select PINCTRL
	help
	  Enables Mikron MIK32 SPI driver.

if SPI_MIK32

config SPI_MIK32_INTERRUPT
	bool "MIK32 MCU SPI Interrupt Support"
	default y if SPI_ASYNC
	help
	  Enable the interrupt driven mode for SPI instances

endif # SPI_MIK32
```

## drivers/timer/Kconfig
```kconfig
# Timer driver configuration options

# Copyright (c) 2024
# SPDX-License-Identifier: Apache-2.0

if SYS_CLOCK_EXISTS

rsource "./Kconfig.*"

endif # SYS_CLOCK_EXISTS
```

## drivers/timer/Kconfig.riscv_scr1_machine
```kconfig
# Copyright (c) 2014-2015 Wind River Systems, Inc.
# Copyright (c) 2016 Cadence Design Systems, Inc.
# Copyright (c) 2019-2023 Intel Corp.
# SPDX-License-Identifier: Apache-2.0

config RISCV_SCR1_MACHINE_TIMER
	bool "RISCV Machine Timer for Syntacore SCR1"
	default y
	depends on DT_HAS_SYNTACORE_MACHINE_TIMER_ENABLED
	select TICKLESS_CAPABLE
	select TIMER_HAS_64BIT_CYCLE_COUNTER
	help
	  This module implements a kernel device driver for the
	  Syntacore-specific RISCV machine timer.
	  It provides the standard "system clock driver" interfaces.

if RISCV_SCR1_MACHINE_TIMER

config RISCV_SCR1_MACHINE_TIMER_SYSTEM_CLOCK_DIVIDER
	int
	default 319
	help
	  Specifies the division ratio of the system clock supplied to the
	  Syntacire SCR1 timer.

endif
```

## dts/bindings/clock/mikron,mik32-pmgr.yaml
```yaml
# Copyright (c) 2024
# SPDX-License-Identifier: Apache-2.0

description: |
  Mikron PowerManager is a multi-function peripheral in
  charge of clock control (CCTL) for all SoC
  peripherals. This binding represents the clock controller (CCTL).

  To specify the clocks in a peripheral, the standard clocks property needs
  to be used, e.g.:

    gpioa: gpio@xxx {
        ...
        /* cell encodes RCU register offset and control bit position */
        clocks = <&pmgr MIK32_CLOCK_GPIO0>;
        ...
    }

  Predefined clock cells are available in
  mik32-clocks.h header file.

compatible: "mikron,mik32-pmgr"

include: [clock-controller.yaml, base.yaml]

properties:
  reg:
    required: true

  "#clock-cells":
    const: 1

clock-cells:
  - id
```

## dts/bindings/cpu/syntacore,scr1.yaml
```yaml
# Copyright (c) 2024
# SPDX-License-Identifier: Apache-2.0

description: Syntacore SCR1 RISC-V Core

compatible: "syntacore,scr1"

include: riscv,cpus.yaml
```

## dts/bindings/gpio/mikron,mik32-gpio.yaml
```yaml
# Copyright (c) 2024
# SPDX-License-Identifier: Apache-2.0

description: MIK32 GPIO node

compatible: "mikron,mik32-gpio"

include: [gpio-controller.yaml, base.yaml]

properties:
  reg:
    required: true

  clocks:
    required: true

  "#gpio-cells":
    const: 2

gpio-cells:
  - pin
  - flags
```

## dts/bindings/i2c/mikron,mik32-i2c.yaml
```yaml
# Copyright (c) 2025 Excave.ru
# SPDX-License-Identifier: Apache-2.0

description: Mikron MIK32 I2C

compatible: "mikron,mik32-i2c"

include: [i2c-controller.yaml, pinctrl-device.yaml]

properties:
  reg:
    required: true

  interrupts:
    required: true

  clocks:
    required: true

  pinctrl-0:
    required: true

  pinctrl-names:
    required: true
```

## dts/bindings/interrupt-controller/mikron,epic.yaml
```yaml
# Copyright (c) 2024 Escave
# SPDX-License-Identifier: Apache-2.0

description: Mikron EPIC external interrupt controller for mik32

compatible: "mikron,epic"

include: [interrupt-controller.yaml, base.yaml]

properties:
  "#interrupt-cells":
    const: 1

interrupt-cells:
  - irq
```

## dts/bindings/interrupt-controller/mikron,mik32-gpio-irq.yaml
```yaml
# Copyright (c) 2024 Escave
# SPDX-License-Identifier: Apache-2.0

description: Mikron MIK32 GPIO IRQ registers

compatible: "mikron,mik32-gpio-irq"

include: base.yaml

properties:
  reg:
    required: true

  clocks:
    required: true
```

## dts/bindings/memory-controllers/mikron,spifi.yaml
```yaml
# Copyright (c) 2024
# SPDX-License-Identifier: Apache-2.0

description: |
  MIK32 SPIFI Memory Controller.

compatible: "mikron,spifi"

include: [base.yaml]

properties:
  reg:
    required: true
```

## dts/bindings/mtd/mikron,eeprom-8k-blk.yaml
```yaml
# Copyright (c) 2024
# SPDX-License-Identifier: Apache-2.0

description: Micron on-chip EEPROM

compatible: "mikron,eeprom-8k-blk"

include: [eeprom-base.yaml, pinctrl-device.yaml]

properties:
  reg:
    required: true
```

## dts/bindings/serial/mikron,mik32-usart.yaml
```yaml
description: MIKRON MIK32 UART

compatible: "mikron,mik32-usart"

include: [uart-controller.yaml, pinctrl-device.yaml]

properties:
  reg:
    required: true

  interrupts:
    required: true

  clocks:
    required: true
```

## dts/bindings/serial/mikron,usart.yaml
```yaml
description: MIKRON MIK32 UART

compatible: "mikron,usart"

include: [uart-controller.yaml, pinctrl-device.yaml]

properties:
  reg:
    required: true

  interrupts:
    required: true

  clocks:
    required: true
```

## dts/bindings/spi/mikron,mik32-spi.yaml
```yaml
# Copyright (c) 2025 Excave.ru
# SPDX-License-Identifier: Apache-2.0

description: Mikron MIK32 SPI

compatible: "mikron,mik32-spi"

include: [spi-controller.yaml, pinctrl-device.yaml]

properties:
  reg:
    required: true

  interrupts:
    required: true

  clocks:
    required: true

  pinctrl-0:
    required: true

  pinctrl-names:
    required: true
```
